## Kconfig
```kconfig
config ZMK_BEHAVIOR_FIXED_LOCALITY
    bool "Fixed locality behavior"
    default y
    depends on DT_HAS_ZMK_BEHAVIOR_FIXED_LOCALITY_ENABLED || \
               DT_HAS_ZMK_BEHAVIOR_FIXED_LOCALITY_ONE_PARAM_ENABLED || \
               DT_HAS_ZMK_BEHAVIOR_FIXED_LOCALITY_TWO_PARAM_ENABLED
    help
      Forward behavior arguments and key events to a locality fixed in devicetree.
```

## dts/bindings/behaviors/fixed-locality-base.yaml
```yaml
properties:
  locality:
    type: int
    required: true
    description: Fixed execution locality or peripheral source ID
  bindings:
    type: phandles
    required: true
    description: Single behavior whose arguments are forwarded unchanged
```

## dts/bindings/behaviors/zmk,behavior-fixed-locality-one-param.yaml
```yaml
description: Invoke a one-argument behavior with a fixed locality
compatible: "zmk,behavior-fixed-locality-one-param"
include: [one_param.yaml, fixed-locality-base.yaml]
```

## dts/bindings/behaviors/zmk,behavior-fixed-locality-two-param.yaml
```yaml
description: Invoke a two-argument behavior with a fixed locality
compatible: "zmk,behavior-fixed-locality-two-param"
include: [two_param.yaml, fixed-locality-base.yaml]
```

## dts/bindings/behaviors/zmk,behavior-fixed-locality.yaml
```yaml
description: Invoke a behavior with a fixed locality
compatible: "zmk,behavior-fixed-locality"
include: [zero_param.yaml, fixed-locality-base.yaml]
```
